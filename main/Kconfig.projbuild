## main/Kconfig.projbuild
```kconfig
menu "App Configuration"
    #rsource "libs/provision/provision.projbuild"
    #rsource "libs/mqtt_tools/mqtt.projbuild"                       
    

    menu "Clock"
        config SNTP_TIME_SERVER
            string "SNTP server name"
            default "pool.ntp.org"
            help
                Hostname of the main SNTP server.
        config TIMEZONE
            string "TIMEZONE"
            default "EET-2EEST,M3.5.0/3,M10.5.0/4"
    endmenu

    menu "Buttons"
        config WAKE_UP_BTN
            int "WAKE_UP_BTN"
            default 0

        config SENSOR_BTN
            int "SENSOR_BTN"
            default 1
    endmenu

endmenu
```
